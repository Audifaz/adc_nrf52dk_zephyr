## build_nrf52dk_nrf52832/Kconfig/Kconfig.modules
```kconfig
osource "/home/audifaz/ncs/nrf/Kconfig.nrf"

osource "/home/audifaz/ncs/bootloader/mcuboot/zephyr/Kconfig"

osource "/home/audifaz/ncs/nrfxlib/Kconfig.nrfxlib"
```

## build_nrf52dk_nrf52832/Kconfig/Kconfig.shield
```kconfig
osource "/home/audifaz/ncs/nrf/boards/shields/*/Kconfig.shield"
osource "/home/audifaz/ncs/zephyr/boards/shields/*/Kconfig.shield"
```

## build_nrf52dk_nrf52832/Kconfig/Kconfig.shield.defconfig
```kconfig
osource "/home/audifaz/ncs/nrf/boards/shields/*/Kconfig.defconfig"
osource "/home/audifaz/ncs/zephyr/boards/shields/*/Kconfig.defconfig"
```

## build_nrf52dk_nrf52832/Kconfig/Kconfig.soc.arch
```kconfig
osource "/home/audifaz/ncs/zephyr/soc/$(ARCH)/Kconfig"
osource "/home/audifaz/ncs/zephyr/soc/$(ARCH)/*/Kconfig"
```
